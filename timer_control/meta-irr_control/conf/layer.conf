## timer_control/meta-irr_control/conf/layer.conf
```bitbake
# We have a conf and classes directory, add to BBPATH
BBPATH .= ":${LAYERDIR}"

# We have recipes-* directories, add to BBFILES
BBFILES += "${LAYERDIR}/recipes-*/*/*.bb \
            ${LAYERDIR}/recipes-*/*/*.bbappend"

BBFILE_COLLECTIONS += "meta-irr_control"
BBFILE_PATTERN_meta-irr_control = "^${LAYERDIR}/"
BBFILE_PRIORITY_meta-irr_control = "50"

LAYERDEPENDS_meta-irr_control = "core"
LAYERSERIES_COMPAT_meta-irr_control = "warrior zeus"
```

## yocto/conf/bblayers.conf
```bitbake
# POKY_BBLAYERS_CONF_VERSION is increased each time build/conf/bblayers.conf
# changes incompatibly
POKY_BBLAYERS_CONF_VERSION = "2"

BBPATH = "${TOPDIR}"
BBFILES ?= ""

BBLAYERS ?= " \
  /home/kt/dev/projects/poky/meta \
  /home/kt/dev/projects/poky/meta-yocto-bsp \
  /home/kt/dev/projects/poky/meta-raspberrypi \
  /home/kt/dev/projects/poky/meta-poky \
  /home/kt/dev/projects/poky/build/workspace \
  /home/kt/dev/projects/poky/meta-irr_control \
  "
```

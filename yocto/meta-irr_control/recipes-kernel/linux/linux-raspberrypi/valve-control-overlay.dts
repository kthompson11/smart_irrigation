/dts-v1/;
/plugin/;

/* Device tree overlay for the valve-control device. */

/{
	compatible = "brcm,bcm2835";

	fragment@0 {
		target = <&spi>;
		__overlay__ {
			#address-cells = <1>;
			#size-cells = <0>;
			status = "okay";

			spidev0: spidev@0 {
				compatible = "my_devices_kt,valve-control";
				reg = <0>;
				#address-cells = <1>;
				#size-cells = <0>;
				spi-max-frequency = <125000000>;
			};
		};
	};
};
